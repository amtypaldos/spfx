## CMakeLists.txt
```
# SP-1 FX audio bring-up image: quiet test tone on headphones / speaker.
# Build: firmware/scripts/build_firmware.sh --app zephyr_tone (see docs/BRINGUP_TONE.md).
# Never flashes.
cmake_minimum_required(VERSION 3.20.0)

find_package(Zephyr REQUIRED HINTS $ENV{ZEPHYR_BASE})
project(sp1fx_zephyr_tone LANGUAGES C)

# Zephyr's sample USB device_next helper (sample_usbd_init_device), the same
# helper Tape Looper uses for its composite device. Only compiled when the USB
# stack is enabled (it is unless no_usb.conf is added).
include(${ZEPHYR_BASE}/samples/subsys/usb/common/common.cmake)

target_sources(app PRIVATE src/main.c src/sp1_codecs.c)
```

## Kconfig
```
# SP-1 FX tone bring-up image Kconfig.
#
# Pulls in Zephyr's USB sample options (CONFIG_SAMPLE_USBD_PID/PRODUCT/...)
# consumed by samples/subsys/usb/common/sample_usbd_init.c, as Tape Looper's
# runtime Kconfig does, then the standard Zephyr Kconfig tree.

source "samples/subsys/usb/common/Kconfig.sample_usbd"

config SP1FX_USB_CONSOLE
	bool "USB CDC ACM status console (one line per second)"
	default y
	depends on USB_DEVICE_STACK_NEXT && USBD_CDC_ACM_CLASS && UART_INTERRUPT_DRIVEN
	help
	  Brings up the board's cdc_acm_uart0 on the device_next USB stack and
	  prints a status line every second. Output is non-blocking: lines are
	  dropped when the host is not reading. Build with no_usb.conf added
	  (build_firmware.sh --app zephyr_tone --no-usb) to leave USB off.

source "Kconfig.zephyr"
```

## prj.conf
```kconfig
# SP-1 FX tone bring-up image: watchdog + LEDs + FN-hold power-off (as
# zephyr_min) plus I2C codecs, I2S (slave) test tone and a USB CDC ACM
# status console. See docs/BRINGUP_TONE.md.

CONFIG_GPIO=y
CONFIG_WATCHDOG=y
CONFIG_I2C=y
CONFIG_I2S=y
CONFIG_FPU=y

# I2S TX queue depth: 4 queued blocks (Zephyr default, same as Tape Looper).
# With 64-frame blocks (1.33 ms each) that is ~5.3 ms queued + 2 in DMA.
CONFIG_I2S_NRFX_TX_BLOCK_COUNT=4

# No printk/console: the status line goes through our own non-blocking
# ring buffer into the CDC ACM UART (src/main.c), never uart_poll_out()
# (which can sleep in a loop when the CDC buffer is full).
CONFIG_CONSOLE=n
CONFIG_UART_CONSOLE=n
CONFIG_PRINTK=n
CONFIG_LOG=n
CONFIG_BOOT_BANNER=n
CONFIG_ASSERT=n

# ---- USB CDC ACM status console (device_next stack, as Tape Looper) ----
CONFIG_SERIAL=y
CONFIG_UART_INTERRUPT_DRIVEN=y
CONFIG_UART_LINE_CTRL=y
CONFIG_USB_DEVICE_STACK_NEXT=y
CONFIG_USBD_CDC_ACM_CLASS=y
# The app owns the USBD context (sample_usbd_init_device), exactly like
# Tape Looper; no second private context built by the CDC SYS_INIT.
CONFIG_CDC_ACM_SERIAL_INITIALIZE_AT_BOOT=n
CONFIG_UDC_ENABLE_SOF=n
# Serial-number string descriptor from FICR (read-only).
CONFIG_HWINFO=y
# VID is fixed by Zephyr v4.3.1's sample helper to 0x2fe3 (Zephyr Project,
# development use). PID 0x0001 is the sample default.
CONFIG_SAMPLE_USBD_PID=0x0001
CONFIG_SAMPLE_USBD_MANUFACTURER="sp1-fx"
CONFIG_SAMPLE_USBD_PRODUCT="SP-1 FX tone test"
# Battery powered; claim 100 mA like Tape Looper.
CONFIG_SAMPLE_USBD_MAX_POWER=50
CONFIG_SP1FX_USB_CONSOLE=y

# USB init (descriptor build + class registration) wants a roomier stack.
CONFIG_MAIN_STACK_SIZE=2048
# main (watchdog, LEDs, I2C, console) runs below the audio thread (prio 0).
CONFIG_MAIN_THREAD_PRIORITY=7

# Same LFCLK source as the board defconfig and Tape Looper's prj.conf.
CONFIG_CLOCK_CONTROL_NRF_K32SRC_SYNTH=y

# Deterministic output.
CONFIG_BUILD_OUTPUT_STRIP_PATHS=y
CONFIG_BUILD_OUTPUT_BIN=y
CONFIG_BUILD_OUTPUT_HEX=y
```

## no_usb.conf
```kconfig
# Optional overlay: build the tone image WITHOUT USB (no status console).
# Use if USB bring-up turns out to disturb the heartbeat/watchdog:
#   firmware/scripts/build_firmware.sh --app zephyr_tone --no-usb
CONFIG_SP1FX_USB_CONSOLE=n
CONFIG_USBD_CDC_ACM_CLASS=n
CONFIG_USB_DEVICE_STACK_NEXT=n
CONFIG_HWINFO=n
CONFIG_UART_LINE_CTRL=n
CONFIG_UART_INTERRUPT_DRIVEN=n
CONFIG_SERIAL=n
```

## app.overlay
```dts
/*
 * SP-1 FX tone bring-up overlay on the stem_player board (firmware/boards).
 *
 * Enabled: i2c0 (CS42L42 0x48, TAS2505 0x18), i2s0 (slave: SCK P0.12 and
 * LRCK P0.11 are inputs, SDOUT P1.09; pinctrl in the board), usbd with the
 * board's cdc_acm_uart0 (status console).
 * Disabled: the board's UAC2 speaker function (not built) and SAADC
 * (bootloader-owned, unused here).
 *
 * Pins (sources: chattock/sp1-tape-looper tools/capacity422/runtime/src/main.c
 * @0359372e, MIT; timknapen/SP-1-dev wiki I2C.md / I2S.md, MIT):
 *   track LEDs 1..4 = P0.29, P0.26, P1.15, P1.14, active-high
 *   FUNCTION        = P0.27, active-low with internal pull-up
 *   OSC_EN          = P0.13 (3.072 MHz oscillator -> I2S SCK), active-high
 *   CS42L42 RESET   = P0.15, active-low
 *   TAS2505 RESET   = P0.09 (NFC1 pad), active-low
 */

&zephyr_user {
	heartbeat-led-gpios = <&gpio0 29 GPIO_ACTIVE_HIGH>;   /* LED 1 */
	cs42-led-gpios      = <&gpio0 26 GPIO_ACTIVE_HIGH>;   /* LED 2 */
	tas-led-gpios       = <&gpio1 15 GPIO_ACTIVE_HIGH>;   /* LED 3 */
	i2s-led-gpios       = <&gpio1 14 GPIO_ACTIVE_HIGH>;   /* LED 4 */
	fn-gpios            = <&gpio0 27 (GPIO_ACTIVE_LOW | GPIO_PULL_UP)>;
	osc-en-gpios        = <&gpio0 13 GPIO_ACTIVE_HIGH>;
	cs42-rst-gpios      = <&gpio0 15 GPIO_ACTIVE_LOW>;
	tas-rst-gpios       = <&gpio0 9 GPIO_ACTIVE_LOW>;
};

&uac2_speaker { status = "disabled"; };
&adc  { status = "disabled"; };
```

## src/main.c
```c
/*
 * SP-1 FX audio bring-up image: a QUIET test tone.
 *
 * NOT TESTED ON HARDWARE. What it is meant to do (docs/BRINGUP_TONE.md):
 *   - everything zephyr_min does: feed the bootloader's watchdog (< 5 s),
 *     heartbeat on track LED 1, FUNCTION held 1.5 s -> SYSTEM_OFF,
 *   - power the 3.072 MHz oscillator (P0.13), release the CS42L42 / TAS2505
 *     resets, configure both codecs over I2C (both outputs muted during setup),
 *   - stream 48 kHz stereo 16-bit I2S as a CLOCK SLAVE (oscillator drives SCK,
 *     CS42L42 drives LRCK) in 64-frame blocks from a static k_mem_slab:
 *     440 Hz on the LEFT channel, 660 Hz on the RIGHT, each -30 dBFS peak,
 *     faded in over 1.5 s,
 *   - headphones in (CS42L42 tip sense) -> speaker muted, headphones on;
 *     otherwise headphones muted, speaker on. Re-checked every 250 ms; every
 *     switch ramps the digital level to zero first (30 ms), swaps the mutes,
 *     then fades back in over 1.5 s,
 *   - LED 2 = CS42L42 answered with DEVID 0x42, LED 3 = TAS2505 ACKed,
 *     LED 4 = I2S stream running without errors in the last second,
 *   - USB CDC ACM status line once per second (non-blocking, lines dropped if
 *     the host is not reading). Optional: build with no_usb.conf.
 *
 * SP-1 bootloader rules ("BIG FIVE"): app at 0x20000 (check_image.py), WDT fed
 * < 5 s, no re-init of bootloader-owned clocks/peripherals beyond what Tape
 * Looper does (Zephyr clock driver, USBD, I2S, TWIM; SAADC/PWM untouched
 * except the guarded LED-pin release), SYSTEM_OFF as the way back to the
 * bootloader, RESETREAS cleared at boot and before SYSTEM_OFF.
 *
 * New code for SP-1 FX. Codec register sequences live in sp1_codecs.c
 * (adapted from chattock/sp1-tape-looper, MIT). The I2S configuration (slave,
 * 16-bit, I2S format, prime-then-START, drop/re-prime on error) follows Tape
 * Looper's audio_thread(); the watchdog/power-off code is zephyr_min's.
 *
 * SPDX-License-Identifier: MIT
 */

#include <zephyr/kernel.h>
#include <zephyr/device.h>
#include <zephyr/devicetree.h>
#include <zephyr/drivers/gpio.h>
#include <zephyr/drivers/i2s.h>
#include <zephyr/drivers/watchdog.h>
#include <zephyr/irq.h>
#include <zephyr/sys/printk.h>
#include <hal/nrf_gpio.h>
#include <nrfx.h>
#include <math.h>
#include <string.h>

#include "sp1_codecs.h"

#ifdef CONFIG_SP1FX_USB_CONSOLE
#include <zephyr/drivers/uart.h>
#include <zephyr/sys/ring_buffer.h>
#include <zephyr/usb/usbd.h>
#include <sample_usbd.h>
#endif

#define LOOP_MS          10
#define BLINK_HALF_MS    500
#define FN_HOLD_OFF_MS   1500
#define FN_RELEASE_MS    60
#define HP_POLL_MS       250
#define STATUS_MS        1000

/* ---------------------------- audio constants ---------------------------- */
#define FS_HZ            48000
#define BLK_FRAMES       64                       /* 1.333 ms per block */
#define BLK_BYTES        (BLK_FRAMES * 2 * (int)sizeof(int16_t))
/* 4 queued (CONFIG_I2S_NRFX_TX_BLOCK_COUNT) + 2 latched in EasyDMA + 1 being
 * rendered + 1 spare for the re-prime after an error (Tape Looper's count). */
#define SLAB_BLOCKS      8
#define PRIME_BLOCKS     4
#define TONE_L_HZ        440.0f
#define TONE_R_HZ        660.0f
/* HEARING SAFETY: -30 dBFS peak = 10^(-30/20) = 0.0316 of full scale
 * (|sample| <= 1036 of 32767). */
#define TONE_LEVEL       0.0316228f
#define FADE_IN_S        1.5f     /* >= 1 s, every time an output turns on */
#define FADE_OUT_S       0.03f    /* ramp to zero before any mute change   */
#define CPU_HZ           64000000u

K_MEM_SLAB_DEFINE_STATIC(tx_slab, BLK_BYTES, SLAB_BLOCKS, 4);

static const struct device *const i2s_dev = DEVICE_DT_GET(DT_NODELABEL(i2s0));
static const struct device *const wdt = DEVICE_DT_GET(DT_ALIAS(watchdog0));

#define ZU DT_PATH(zephyr_user)
static const struct gpio_dt_spec led_hb   = GPIO_DT_SPEC_GET(ZU, heartbeat_led_gpios);
static const struct gpio_dt_spec led_cs42 = GPIO_DT_SPEC_GET(ZU, cs42_led_gpios);
static const struct gpio_dt_spec led_tas  = GPIO_DT_SPEC_GET(ZU, tas_led_gpios);
static const struct gpio_dt_spec led_i2s  = GPIO_DT_SPEC_GET(ZU, i2s_led_gpios);
static const struct gpio_dt_spec fn       = GPIO_DT_SPEC_GET(ZU, fn_gpios);
static const struct gpio_dt_spec osc_en   = GPIO_DT_SPEC_GET(ZU, osc_en_gpios);
static const struct gpio_dt_spec cs42_rst = GPIO_DT_SPEC_GET(ZU, cs42_rst_gpios);
static const struct gpio_dt_spec tas_rst  = GPIO_DT_SPEC_GET(ZU, tas_rst_gpios);

/* Kept in RAM for a debugger; also printed on the console. */
volatile uint32_t sp1fx_boot_resetreas;

/* ------------------------ audio thread shared state ---------------------- */
static volatile bool     g_out_enable;     /* main -> audio: ramp target 1 or 0 */
static volatile bool     g_audio_stop;     /* main -> audio: park (power-off)   */
static volatile bool     g_gain_zero = true; /* audio -> main: level is exactly 0 */
static volatile int      g_i2s_cfg_rc = 1;
static volatile int      g_i2s_start_rc = 1;
static volatile uint32_t g_blocks;         /* successful i2s_write() calls      */
static volatile uint32_t g_err;            /* i2s_write() errors (-EIO etc.)    */
static volatile uint32_t g_tmo;            /* i2s_write() timeouts (-EAGAIN)    */
static volatile uint32_t g_recover;        /* DROP + re-prime + START cycles    */
static volatile uint32_t g_gen_us_max;     /* max render time of one block      */
static volatile uint32_t g_period_us_max;  /* max time between two good writes  */

struct osc {
	float c, s, cw, sw;
};

static void osc_init(struct osc *o, float hz)
{
	const float w = 2.0f * 3.14159265358979f * hz / (float)FS_HZ;

	o->c = 1.0f;
	o->s = 0.0f;
	o->cw = cosf(w);
	o->sw = sinf(w);
}

/* Quadrature (rotation) oscillator: exact sine without a table. The repo's
 * fx_sin01() (firmware/dsp/util.h) is a ~3 % shape-error LFO approximation and
 * would add audible harmonics to a test tone, so it is not used here. */
static inline float osc_step(struct osc *o)
{
	const float c = o->c * o->cw - o->s * o->sw;
	const float s = o->s * o->cw + o->c * o->sw;

	o->c = c;
	o->s = s;
	return s;
}

static inline void osc_renorm(struct osc *o)
{
	const float g = 1.5f - 0.5f * (o->c * o->c + o->s * o->s);

	o->c *= g;
	o->s *= g;
}

static struct osc osc_l, osc_r;
static float g_gain;   /* audio thread only */

static void render_block(int16_t *buf)
{
	const float up = 1.0f / (FADE_IN_S * (float)FS_HZ);
	const float down = 1.0f / (FADE_OUT_S * (float)FS_HZ);
	const float target = g_out_enable ? 1.0f : 0.0f;
	const float amp = TONE_LEVEL * 32767.0f;
	float g = g_gain;

	for (int i = 0; i < BLK_FRAMES; i++) {
		if (g < target) {
			g += up;
			if (g > target) {
				g = target;
			}
		} else if (g > target) {
			g -= down;
			if (g < target) {
				g = target;
			}
		}
		const float a = amp * g;
		/* nRF I2S, 16-bit stereo: each 32-bit word = left (low half-word)
		 * then right (high half-word) -> int16 order L, R. */
		buf[2 * i]     = (int16_t)(a * osc_step(&osc_l));
		buf[2 * i + 1] = (int16_t)(a * osc_step(&osc_r));
	}
	osc_renorm(&osc_l);
	osc_renorm(&osc_r);
	g_gain = g;
	g_gain_zero = (g <= 0.0f);
}

static void prime_and_start(void)
{
	for (int i = 0; i < PRIME_BLOCKS; i++) {
		void *pb;

		if (k_mem_slab_alloc(&tx_slab, &pb, K_NO_WAIT) != 0) {
			break;
		}
		memset(pb, 0, BLK_BYTES);
		if (i2s_write(i2s_dev, pb, BLK_BYTES) != 0) {
			k_mem_slab_free(&tx_slab, pb);
		}
	}
	g_i2s_start_rc = i2s_trigger(i2s_dev, I2S_DIR_TX, I2S_TRIGGER_START);
}

static K_THREAD_STACK_DEFINE(audio_stack, 1024);
static struct k_thread audio_tcb;

static void audio_thread(void *a, void *b, void *c)
{
	ARG_UNUSED(a); ARG_UNUSED(b); ARG_UNUSED(c);

	/* Same configuration as Tape Looper's audio_thread(): both clocks are
	 * inputs (SCK from the oscillator, LRCK from the CS42L42), 16-bit words,
	 * Philips I2S format. With a 64-SCLK frame the nRF shifts the 16 MSBs of
	 * each 32-SCLK half-frame (Tape Looper comment; the codecs are set for
	 * 16-bit (TAS2505) and 24-bit (CS42L42) MSB-first slots). */
	struct i2s_config cfg = {
		.word_size      = 16,
		.channels       = 2,
		.format         = I2S_FMT_DATA_FORMAT_I2S,
		.options        = I2S_OPT_FRAME_CLK_SLAVE | I2S_OPT_BIT_CLK_SLAVE,
		.frame_clk_freq = FS_HZ,
		.mem_slab       = &tx_slab,
		.block_size     = BLK_BYTES,
		/* i2s_write() waits at most this long for queue space; with no
		 * LRCK yet it times out and is counted, never blocks forever. */
		.timeout        = 100,
	};

	osc_init(&osc_l, TONE_L_HZ);
	osc_init(&osc_r, TONE_R_HZ);

	if (!device_is_ready(i2s_dev)) {
		g_i2s_cfg_rc = -100;
		return;
	}
	g_i2s_cfg_rc = i2s_configure(i2s_dev, I2S_DIR_TX, &cfg);
	if (g_i2s_cfg_rc != 0) {
		return;
	}
	prime_and_start();

	uint32_t last_ok = DWT->CYCCNT;

	for (;;) {
		void *blk;

		if (g_audio_stop) {
			k_sleep(K_FOREVER);
		}
		if (k_mem_slab_alloc(&tx_slab, &blk, K_MSEC(100)) != 0) {
			g_tmo++;
			continue;
		}

		const uint32_t t0 = DWT->CYCCNT;

		render_block(blk);

		const uint32_t gen_us = (DWT->CYCCNT - t0) / (CPU_HZ / 1000000u);

		if (gen_us > g_gen_us_max) {
			g_gen_us_max = gen_us;
		}

		const int rc = i2s_write(i2s_dev, blk, BLK_BYTES);

		if (rc == 0) {
			const uint32_t now = DWT->CYCCNT;
			const uint32_t per = (now - last_ok) / (CPU_HZ / 1000000u);

			if (per > g_period_us_max) {
				g_period_us_max = per;
			}
			last_ok = now;
			g_blocks++;
			continue;
		}
		k_mem_slab_free(&tx_slab, blk);
		if (rc == -EAGAIN) {
			g_tmo++;             /* queue full and not draining: no clocks? */
			continue;
		}
		/* -EIO: the driver went to its ERROR state (e.g. "next buffers not
		 * supplied on time" = underrun) and refuses writes until restarted.
		 * Same failsafe as Tape Looper: drop, re-prime with silence, start. */
		g_err++;
		if (g_audio_stop) {
			continue;
		}
		(void)i2s_trigger(i2s_dev, I2S_DIR_TX, I2S_TRIGGER_DROP);
		prime_and_start();
		g_recover++;
		last_ok = DWT->CYCCNT;
	}
}

/* ------------------------------ USB console ------------------------------ */
#ifdef CONFIG_SP1FX_USB_CONSOLE
static const struct device *const cdc = DEVICE_DT_GET(DT_NODELABEL(cdc_acm_uart0));
RING_BUF_DECLARE(con_rb, 1024);
static struct k_spinlock con_lock;
static bool usb_ok;
static int usb_rc = 1;

/* Runs in the CDC ACM work-queue context (the only context allowed to call
 * uart_fifo_fill on this stack). Moves bytes from our ring into the CDC
 * ring; never waits. */
static void cdc_cb(const struct device *dev, void *user)
{
	ARG_UNUSED(user);

	if (!uart_irq_update(dev) || !uart_irq_tx_ready(dev)) {
		return;
	}
	k_spinlock_key_t key = k_spin_lock(&con_lock);
	uint8_t *p;
	uint32_t n = ring_buf_get_claim(&con_rb, &p, 64);
	int w = (n > 0u) ? uart_fifo_fill(dev, p, (int)n) : 0;

	if (w < 0) {
		w = 0;
	}
	(void)ring_buf_get_finish(&con_rb, (uint32_t)w);
	bool empty = ring_buf_is_empty(&con_rb);

	k_spin_unlock(&con_lock, key);
	if (empty) {
		uart_irq_tx_disable(dev);
	}
}

static void usb_console_start(void)
{
	struct usbd_context *ctx;

	if (!device_is_ready(cdc)) {
		usb_rc = -100;
		return;
	}
	ctx = sample_usbd_init_device(NULL);
	if (ctx == NULL) {
		usb_rc = -101;
		return;
	}
	usb_rc = usbd_enable(ctx);
	if (usb_rc != 0) {
		return;
	}
	uart_irq_callback_user_data_set(cdc, cdc_cb, NULL);
	usb_ok = true;
}

static bool con_host_open(void)
{
	uint32_t dtr = 0;

	if (!usb_ok) {
		return false;
	}
	(void)uart_line_ctrl_get(cdc, UART_LINE_CTRL_DTR, &dtr);
	return dtr != 0u;
}
#endif

static uint32_t con_drops;

/* Non-blocking: whole line or nothing. */
static void con_write(const char *s, int len)
{
#ifdef CONFIG_SP1FX_USB_CONSOLE
	if (len <= 0 || !con_host_open()) {
		return;
	}
	k_spinlock_key_t key = k_spin_lock(&con_lock);
	bool fits = ring_buf_space_get(&con_rb) >= (uint32_t)len;

	if (fits) {
		(void)ring_buf_put(&con_rb, (const uint8_t *)s, (uint32_t)len);
	}
	k_spin_unlock(&con_lock, key);
	if (fits) {
		uart_irq_tx_enable(cdc);
	} else {
		con_drops++;
	}
#else
	ARG_UNUSED(s);
	ARG_UNUSED(len);
#endif
}

/* ------------------------- watchdog / LEDs / power ----------------------- */

/* Reload every channel: the bootloader may have enabled more than one RREN
 * channel (Tape Looper feeds all 8 the same way). */
static void feed_wdt(void)
{
	for (int ch = 0; ch < 8; ch++) {
		NRF_WDT->RR[ch] = WDT_RR_RR_Reload;
	}
}

/* GUESS (untested), as in zephyr_min: if an enabled PWM instance (the
 * bootloader starts PWM2/PWM3) is routed to one of our LED pins, stop and
 * disable it so GPIO can drive the pin. Otherwise nothing is touched. */
static void release_pwm_claim(uint32_t abs_pin)
{
	NRF_PWM_Type *const pwms[] = { NRF_PWM0, NRF_PWM1, NRF_PWM2, NRF_PWM3 };

	for (size_t i = 0; i < ARRAY_SIZE(pwms); i++) {
		NRF_PWM_Type *p = pwms[i];
		bool routed = false;

		if (p->ENABLE == 0u) {
			continue;
		}
		for (int c = 0; c < 4; c++) {
			uint32_t psel = p->PSEL.OUT[c];
			bool connected = (psel & PWM_PSEL_OUT_CONNECT_Msk) == 0u;
			uint32_t pin = psel & (PWM_PSEL_OUT_PIN_Msk | PWM_PSEL_OUT_PORT_Msk);

			if (connected && pin == abs_pin) {
				routed = true;
			}
		}
		if (!routed) {
			continue;
		}
		p->EVENTS_STOPPED = 0u;
		p->TASKS_STOP = 1u;
		for (int t = 0; t < 1000 && p->EVENTS_STOPPED == 0u; t++) {
			k_busy_wait(1);
		}
		p->ENABLE = 0u;
	}
}

static uint32_t abs_pin(const struct gpio_dt_spec *g)
{
	const uint32_t port = (g->port == DEVICE_DT_GET(DT_NODELABEL(gpio1))) ? 1u : 0u;

	return NRF_GPIO_PIN_MAP(port, g->pin);
}

static bool fn_pressed(void)
{
	return gpio_pin_get_dt(&fn) > 0;
}

/* Sleep in small steps, feeding the watchdog. */
static void wait_fed(int ms)
{
	while (ms > 0) {
		feed_wdt();
		k_msleep(ms > 20 ? 20 : ms);
		ms -= 20;
	}
	feed_wdt();
}

/* Wait until the audio thread has ramped to exactly zero, plus the queued
 * blocks (<= 6 x 1.33 ms) have played out. Bounded at ~150 ms. */
static void wait_silent(void)
{
	for (int t = 0; t < 10 && !g_gain_zero; t++) {
		wait_fed(10);
	}
	wait_fed(15);
}

static bool cs42_ok, tas_ok, cs42_cfg_ok, tas_cfg_ok;

static FUNC_NORETURN void power_off(void)
{
	/* Silence first (digital ramp), then mute and park everything. */
	g_out_enable = false;
	wait_silent();
	if (tas_ok || cs42_ok) {
		sp1_codecs_shutdown();
	}
	g_audio_stop = true;
	(void)i2s_trigger(i2s_dev, I2S_DIR_TX, I2S_TRIGGER_DROP);
	(void)gpio_pin_set_dt(&tas_rst, 1);    /* assert resets (active-low pins) */
	(void)gpio_pin_set_dt(&cs42_rst, 1);
	(void)gpio_pin_set_dt(&osc_en, 0);     /* oscillator off (battery drain) */

	(void)gpio_pin_set_dt(&led_hb, 0);
	(void)gpio_pin_set_dt(&led_cs42, 0);
	(void)gpio_pin_set_dt(&led_tas, 0);
	(void)gpio_pin_set_dt(&led_i2s, 0);

	/* Wait for release first, or the level sense armed below would wake
	 * the chip immediately. Keep feeding the watchdog meanwhile. */
	while (fn_pressed()) {
		feed_wdt();
		k_msleep(20);
	}
	feed_wdt();
	k_msleep(FN_RELEASE_MS);

	nrf_gpio_cfg_sense_input(NRF_GPIO_PIN_MAP(0, fn.pin), NRF_GPIO_PIN_PULLUP,
				 NRF_GPIO_PIN_SENSE_LOW);

	(void)irq_lock();
	feed_wdt();
	NRF_POWER->RESETREAS = 0xFFFFFFFFu;  /* write-1-to-clear, before SYSTEM_OFF */
	__DSB();
	NRF_POWER->SYSTEMOFF = 1u;
	__DSB();
	for (;;) {
		/* CPU is off; FUNCTION press wakes via reset into the bootloader */
	}
}

/* ------------------------------ output select ---------------------------- */
enum out { OUT_NONE, OUT_SPK, OUT_HP };
static const char *const out_name[] = { "none", "spk", "hp" };
static enum out cur_out = OUT_NONE;
static int hp_in = -1;          /* debounced: 1 in, 0 out, -1 unknown */
static int hp_raw = -1;         /* last raw read */

static enum out wanted_out(void)
{
	if (hp_in == 1 && cs42_cfg_ok) {
		return OUT_HP;
	}
	if (tas_cfg_ok) {
		return OUT_SPK;
	}
	return OUT_NONE;
}

/* Must be called with the digital level at zero (wait_silent()). */
static void apply_out(enum out o)
{
	/* mute the old output first, then unmute the new one */
	if (cur_out == OUT_SPK || o != OUT_SPK) {
		if (tas_cfg_ok) {
			(void)tas_spk_enable(false);
		}
	}
	if (cur_out == OUT_HP || o != OUT_HP) {
		if (cs42_cfg_ok) {
			(void)cs42_hp_enable(false);
		}
	}
	if (o == OUT_SPK) {
		(void)tas_spk_enable(true);
	} else if (o == OUT_HP) {
		(void)cs42_hp_enable(true);
	}
	cur_out = o;
	g_out_enable = (o != OUT_NONE);   /* fade back in over FADE_IN_S */
}

static void dwt_enable(void)
{
	CoreDebug->DEMCR |= CoreDebug_DEMCR_TRCENA_Msk;
	DWT->CYCCNT = 0u;
	DWT->CTRL |= DWT_CTRL_CYCCNTENA_Msk;
}

int main(void)
{
	/* BIG FIVE: capture then clear RESETREAS at boot. */
	sp1fx_boot_resetreas = NRF_POWER->RESETREAS;
	NRF_POWER->RESETREAS = 0xFFFFFFFFu;
	feed_wdt();

	/* Same calls as Tape Looper / zephyr_min: the WDT is already running,
	 * the register-level feed is what keeps the device alive. */
	if (device_is_ready(wdt)) {
		struct wdt_timeout_cfg cfg = {
			.window.min = 0U,
			.window.max = 4000U,
			.callback = NULL,
			.flags = WDT_FLAG_RESET_SOC,
		};
		(void)wdt_install_timeout(wdt, &cfg);
		(void)wdt_setup(wdt, 0);
	}
	feed_wdt();

	const struct gpio_dt_spec *leds[] = { &led_hb, &led_cs42, &led_tas, &led_i2s };

	for (size_t i = 0; i < ARRAY_SIZE(leds); i++) {
		release_pwm_claim(abs_pin(leds[i]));
		(void)gpio_pin_configure_dt(leds[i], GPIO_OUTPUT_INACTIVE);
	}
	(void)gpio_pin_configure_dt(&fn, GPIO_INPUT);

	/* Codec power-up order (Tim Knapen's wiki, CS42L42 datasheet 5.1):
	 * hold RESET, start SCLK (oscillator), release RESET, wait >= 2.5 ms.
	 * TAS2505: no register writes within 1 ms of reset release. */
	(void)gpio_pin_configure_dt(&cs42_rst, GPIO_OUTPUT_ACTIVE);  /* in reset */
	(void)gpio_pin_configure_dt(&tas_rst, GPIO_OUTPUT_ACTIVE);   /* in reset */
	(void)gpio_pin_configure_dt(&osc_en, GPIO_OUTPUT_INACTIVE);
	dwt_enable();

#ifdef CONFIG_SP1FX_USB_CONSOLE
	usb_console_start();
	feed_wdt();
#endif

	k_msleep(2);
	(void)gpio_pin_set_dt(&osc_en, 1);
	k_msleep(2);
	(void)gpio_pin_set_dt(&cs42_rst, 0);
	(void)gpio_pin_set_dt(&tas_rst, 0);
	wait_fed(10);

	uint8_t devid[3] = { 0 };

	if (sp1_i2c_ready()) {
		cs42_ok = cs42_probe(devid);
		tas_ok = tas_probe();
	}
	(void)gpio_pin_set_dt(&led_cs42, cs42_ok ? 1 : 0);
	(void)gpio_pin_set_dt(&led_tas, tas_ok ? 1 : 0);

	/* I2S first (slave: it waits for clocks), then TAS2505 (PLL locks to the
	 * oscillator BCLK), then CS42L42 (starts LRCK). Same order as Tape
	 * Looper: audio_init() -> tas2505_configure() -> hp_init(). */
	k_thread_create(&audio_tcb, audio_stack, K_THREAD_STACK_SIZEOF(audio_stack),
			audio_thread, NULL, NULL, NULL, K_PRIO_PREEMPT(0), K_FP_REGS,
			K_NO_WAIT);
	k_thread_name_set(&audio_tcb, "tone");
	wait_fed(5);

	if (tas_ok) {
		tas_cfg_ok = tas_configure();
	}
	feed_wdt();
	if (cs42_ok) {
		cs42_cfg_ok = cs42_configure();
	}
	feed_wdt();

	/* Give LRCK time to appear and the stream to run (<= 500 ms). */
	for (int t = 0; t < 50 && g_blocks < 100u; t++) {
		wait_fed(10);
	}

	if (cs42_cfg_ok) {
		int votes = 0, reads = 0;

		for (int i = 0; i < 3; i++) {
			int c = cs42_hp_present();

			if (c >= 0) {
				reads++;
				votes += c;
			}
			hp_raw = c;
			wait_fed(8);
		}
		hp_in = (reads > 0) ? ((votes * 2 > reads) ? 1 : 0) : -1;
	}
	apply_out(wanted_out());   /* level is still 0: g_out_enable was false */

	bool fn_armed = !fn_pressed();
	int64_t fn_down_at = -1;
	int64_t now = k_uptime_get();
	int64_t next_toggle = now + BLINK_HALF_MS;
	int64_t next_hp = now + HP_POLL_MS;
	int64_t next_status = now + STATUS_MS;
	bool led_on = false;
	int hp_cand = -1, hp_cnt = 0;
	uint32_t prev_blocks = g_blocks, prev_err = g_err, prev_tmo = g_tmo;

	for (;;) {
		feed_wdt();
		now = k_uptime_get();

		if (now >= next_toggle) {
			led_on = !led_on;
			(void)gpio_pin_set_dt(&led_hb, led_on ? 1 : 0);
			next_toggle += BLINK_HALF_MS;
		}

		if (fn_pressed()) {
			if (fn_armed) {
				if (fn_down_at < 0) {
					fn_down_at = now;
				} else if (now - fn_down_at >= FN_HOLD_OFF_MS) {
					power_off();
				}
			}
		} else {
			fn_armed = true;
			fn_down_at = -1;
		}

		if (now >= next_hp) {
			next_hp += HP_POLL_MS;
			if (cs42_cfg_ok) {
				int c = cs42_hp_present();

				hp_raw = c;
				if (c >= 0) {   /* failed reads hold the last state */
					if (c == hp_cand) {
						hp_cnt++;
					} else {
						hp_cand = c;
						hp_cnt = 1;
					}
					if (hp_cnt >= 2) {
						hp_in = c;
					}
				}
			}
			enum out w = wanted_out();

			if (w != cur_out) {
				/* ramp to zero, swap mutes, fade back in */
				g_out_enable = false;
				wait_silent();
				apply_out(w);
			}
		}

		if (now >= next_status) {
			next_status += STATUS_MS;

			const uint32_t b = g_blocks, e = g_err, tm = g_tmo;
			const uint32_t db = b - prev_blocks;
			const bool running = db >= 700u && e == prev_err && tm == prev_tmo;
			const uint32_t gen = g_gen_us_max, per = g_period_us_max;

			g_gen_us_max = 0u;
			g_period_us_max = 0u;
			prev_blocks = b;
			prev_err = e;
			prev_tmo = tm;
			(void)gpio_pin_set_dt(&led_i2s, running ? 1 : 0);

			char line[200];
			int n = snprintk(line, sizeof(line),
				"t=%u cs42=%02x%02x%02x%s clk=%02x tas=%s%s hp=%d out=%s "
				"i2s=%s cfg=%d/%d blk/s=%u err=%u tmo=%u rec=%u "
				"gen_us=%u per_us=%u drop=%u rr=%x\r\n",
				(unsigned int)(now / 1000), devid[0], devid[1], devid[2],
				cs42_cfg_ok ? "+" : (cs42_ok ? "!" : "-"),
				cs42_clk_status(),
				tas_ok ? "ack" : "nak", tas_cfg_ok ? "+" : "-",
				hp_raw, out_name[cur_out],
				running ? "run" : "STALL", g_i2s_cfg_rc, g_i2s_start_rc,
				(unsigned int)db, (unsigned int)e, (unsigned int)tm,
				(unsigned int)g_recover, (unsigned int)gen,
				(unsigned int)per, (unsigned int)con_drops,
				(unsigned int)sp1fx_boot_resetreas);

			if (n > 0) {
				con_write(line, MIN(n, (int)sizeof(line) - 1));
			}
		}

		k_msleep(LOOP_MS);
	}
	return 0;
}
```

## src/sp1_codecs.c
```c
/*
 * SP-1 audio codecs over I2C: CS42L42 headphone codec (0x48) and TAS2505
 * speaker amp (0x18).
 *
 * MIT License
 *
 * Copyright (c) 2026 chattock
 *
 * Permission is hereby granted, free of charge, to any person obtaining a copy
 * of this software and associated documentation files (the "Software"), to deal
 * in the Software without restriction, including without limitation the rights
 * to use, copy, modify, merge, publish, distribute, sublicense, and/or sell
 * copies of the Software, and to permit persons to whom the Software is
 * furnished to do so, subject to the following conditions:
 *
 * The above copyright notice and this permission notice shall be included in
 * all copies or substantial portions of the Software.
 *
 * THE SOFTWARE IS PROVIDED "AS IS", WITHOUT WARRANTY OF ANY KIND, EXPRESS OR
 * IMPLIED, INCLUDING BUT NOT LIMITED TO THE WARRANTIES OF MERCHANTABILITY,
 * FITNESS FOR A PARTICULAR PURPOSE AND NONINFRINGEMENT. IN NO EVENT SHALL THE
 * AUTHORS OR COPYRIGHT HOLDERS BE LIABLE FOR ANY CLAIM, DAMAGES OR OTHER
 * LIABILITY, WHETHER IN AN ACTION OF CONTRACT, TORT OR OTHERWISE, ARISING FROM,
 * OUT OF OR IN CONNECTION WITH THE SOFTWARE OR THE USE OR OTHER DEALINGS IN THE
 * SOFTWARE.
 *
 * SPDX-License-Identifier: MIT
 *
 * PROVENANCE
 *   Adapted from chattock/sp1-tape-looper commit 0359372e11f61d74a85e2e4449178a5c62010664,
 *   tools/capacity422/runtime/src/main.c: tas_wr()/tas_page()/tas_set_speaker(),
 *   tas2505_configure(), tpw()/tpr() paged CS42L42 access, hp_detect_connected()
 *   and the HP_TIM_TEST branch of hp_codec_init() (which itself is Tim Knapen's
 *   SP-1-dev wiki I2C.md sequence, MIT, Copyright (c) 2026 Tim Knapen).
 *   Register addresses and values are kept as in Tape Looper EXCEPT the
 *   hearing-safety / pop changes marked "SP1FX:" below:
 *     - both outputs are configured MUTED and only unmuted later by the app,
 *       after the I2S stream runs and with the digital signal at zero,
 *     - CS42L42 mixer volume -30 dB instead of 0 dB,
 *     - TAS2505 class-D gain +6 dB (minimum non-mute step) instead of +18 dB
 *       and speaker attenuation -6 dB instead of 0 dB,
 *     - mute/unmute helpers for headphone-detect switching.
 *   Rewritten as small functions without Tape Looper's globals.
 */
#include "sp1_codecs.h"

#include <zephyr/kernel.h>
#include <zephyr/device.h>
#include <zephyr/devicetree.h>
#include <zephyr/drivers/i2c.h>

static const struct device *const i2c_bus = DEVICE_DT_GET(DT_NODELABEL(i2c0));

/* ---- volume choices (SP1FX: hearing safety) ----------------------------------
 * CS42L42 MIXER_CHA_VOL / MIXER_CHB_VOL (0x2301 / 0x2303), 6-bit attenuation.
 * GUESS from the Linux cs42l42 driver's TLV (from memory, not re-verified
 * against the datasheet): 0x00 = 0 dB (the loudest setting, which Tape Looper
 * and Tim's wiki use), 1 dB per step, 0x3F = mute.
 * We use 0x1E = -30 dB: 30 dB below the register maximum. With the -30 dBFS
 * tone the headphone signal is ~-60 dB below the codec's full-scale output
 * (roughly 1 Vrms class for this codec family) -> about 1 mVrms, i.e. well
 * under 0.1 uW into 16-32 ohm phones: quiet but audible next to the ear even
 * with sensitive in-ear monitors. If 0x3F is NOT mute on this part the
 * analog HP mute in HP_CTL still silences the output. */
#define CS42_HP_MIX_ATT   0x1Eu   /* -30 dB (register max loudness is 0x00) */
#define CS42_MIX_MUTE     0x3Fu
#define CS42_HP_CTL_MUTE  0x0Du   /* Tim's wiki "HP Control: mute all" */
#define CS42_HP_CTL_ON    0x01u   /* Tim's wiki "unmute headphones"    */

/* TAS2505 page 1 reg 0x30 (48) class-D driver gain, bits D6-D4:
 * 000 = mute, 001 = +6 dB ... 100 = +24 dB (Tape Looper comment; TI SLAU472C).
 * +6 dB is the smallest non-mute step. Tape Looper ships +18 dB.
 * Page 1 reg 0x2E (46) speaker volume: 0x00 = 0 dB, ~0.5 dB/step (GUESS from
 * SLAU472C table, not re-verified): 0x0C = -6 dB. Tape Looper uses 0x00. */
#define TAS_SPK_GAIN_ON   0x10u   /* +6 dB  */
#define TAS_SPK_GAIN_MUTE 0x00u
#define TAS_SPK_ATT       0x0Cu   /* -6 dB  */
/* Page 0 reg 0x40 (64) DAC mute: Tape Looper writes 0x04 ("not muted": left
 * channel unmuted, right muted). 0x0C sets both mute bits. */
#define TAS_DAC_UNMUTE    0x04u
#define TAS_DAC_MUTE      0x0Cu

bool sp1_i2c_ready(void)
{
	return device_is_ready(i2c_bus);
}

/* ------------------------------- TAS2505 --------------------------------- */

static int tas_wr(uint8_t reg, uint8_t val)
{
	return i2c_reg_write_byte(i2c_bus, TAS2505_ADDR, reg, val);
}

static int tas_page(uint8_t p)
{
	return tas_wr(0x00, p);
}

bool tas_probe(void)
{
	return tas_page(0x00) == 0;
}

/* TAS2505 speaker bring-up (Tape Looper tas2505_configure(), after TI
 * SLAU472C section 5.1). PLL_CLKIN = BCLK = the 3.072 MHz oscillator,
 * J = 32 -> 98.304 MHz, NDAC 2 x MDAC 8 x DOSR 128 -> DAC_FS 48 kHz.
 * BCLK must be running (oscillator on) for the PLL to lock. */
bool tas_configure(void)
{
	int rc = 0;

	rc |= tas_page(0x00);
	rc |= tas_wr(0x01, 0x01);          /* software reset */
	k_msleep(5);

	rc |= tas_page(0x01);
	rc |= tas_wr(0x02, 0x00);          /* LDO 1.8 V, level shifters up */

	rc |= tas_page(0x00);
	rc |= tas_wr(0x04, 0x07);          /* PLL_CLKIN = BCLK, CODEC_CLKIN = PLL */
	rc |= tas_wr(0x05, 0x91);          /* PLL powered, P=1, R=1 */
	rc |= tas_wr(0x06, 0x20);          /* J = 32 */
	rc |= tas_wr(0x07, 0x00);          /* D MSB */
	rc |= tas_wr(0x08, 0x00);          /* D LSB */
	k_msleep(15);                      /* PLL lock */
	rc |= tas_wr(0x0B, 0x82);          /* NDAC = 2, powered */
	rc |= tas_wr(0x0C, 0x88);          /* MDAC = 8, powered */
	rc |= tas_wr(0x0D, 0x00);          /* DOSR MSB */
	rc |= tas_wr(0x0E, 0x80);          /* DOSR = 128 */
	rc |= tas_wr(0x1B, 0x00);          /* I2S, 16-bit, BCLK/WCLK inputs */
	rc |= tas_wr(0x1C, 0x00);          /* data slot offset 0 */
	rc |= tas_wr(0x3C, 0x02);          /* PRB_P2 */

	/* SP1FX: DAC muted BEFORE it is powered (Tape Looper unmutes here). */
	rc |= tas_wr(0x40, TAS_DAC_MUTE);
	rc |= tas_wr(0x3F, 0x90);          /* DAC powered, left data -> DAC, soft-step */
	rc |= tas_wr(0x41, 0x00);          /* DAC digital gain 0 dB */

	rc |= tas_page(0x01);
	rc |= tas_wr(0x01, 0x10);          /* master analog reference on */
	rc |= tas_wr(0x0A, 0x00);          /* common mode 0.9 V */
	rc |= tas_wr(0x0C, 0x04);          /* DAC routed to the output mixer */
	rc |= tas_wr(0x16, 0x00);          /* (TAS HP) volume 0 dB */
	rc |= tas_wr(0x18, 0x00);          /* AINL volume / mixer */
	rc |= tas_wr(0x09, 0x20);          /* (TAS HP) driver power, as Tape Looper */
	rc |= tas_wr(0x10, 0x00);          /* (TAS HP) unmute 0 dB, as Tape Looper */
	/* SP1FX: speaker attenuation -6 dB and the driver gain MUTED before the
	 * driver is powered, so power-up cannot pop through an open gain stage. */
	rc |= tas_wr(0x2E, TAS_SPK_ATT);
	rc |= tas_wr(0x30, TAS_SPK_GAIN_MUTE);
	rc |= tas_wr(0x2D, 0x02);          /* speaker driver powered up */

	rc |= tas_page(0x00);
	k_msleep(10);
	return rc == 0;
}

/* Speaker on/off. Called only while the digital signal is ramped to zero.
 * Order: on = DAC unmute then driver gain; off = driver gain mute then DAC. */
bool tas_spk_enable(bool on)
{
	int rc = 0;

	if (on) {
		rc |= tas_page(0x00);
		rc |= tas_wr(0x40, TAS_DAC_UNMUTE);
		rc |= tas_page(0x01);
		rc |= tas_wr(0x30, TAS_SPK_GAIN_ON);
	} else {
		rc |= tas_page(0x01);
		rc |= tas_wr(0x30, TAS_SPK_GAIN_MUTE);
		rc |= tas_page(0x00);
		rc |= tas_wr(0x40, TAS_DAC_MUTE);
	}
	rc |= tas_page(0x00);
	return rc == 0;
}

/* ------------------------------- CS42L42 --------------------------------- */

static uint8_t cs42_clk;

/* paged write: page register 0x00 first, then the 8-bit offset */
static bool tpw(uint16_t reg, uint8_t val)
{
	uint8_t p[2] = { 0x00, (uint8_t)(reg >> 8) };
	uint8_t b[2] = { (uint8_t)reg, val };

	if (i2c_write(i2c_bus, p, 2, CS42L42_ADDR) != 0) {
		return false;
	}
	return i2c_write(i2c_bus, b, 2, CS42L42_ADDR) == 0;
}

/* paged read */
static bool tpr(uint16_t reg, uint8_t *val)
{
	uint8_t p[2] = { 0x00, (uint8_t)(reg >> 8) };
	uint8_t o = (uint8_t)reg;

	if (i2c_write(i2c_bus, p, 2, CS42L42_ADDR) != 0) {
		return false;
	}
	return i2c_write_read(i2c_bus, CS42L42_ADDR, &o, 1, val, 1) == 0;
}

bool cs42_probe(uint8_t devid[3])
{
	devid[0] = devid[1] = devid[2] = 0;
	(void)tpr(0x1001, &devid[0]);   /* DEVID_AB (0x42 = CS42L42) */
	(void)tpr(0x1002, &devid[1]);   /* DEVID_CD */
	(void)tpr(0x1003, &devid[2]);   /* DEVID_E  */
	return devid[0] == 0x42;
}

uint8_t cs42_clk_status(void)
{
	return cs42_clk;
}

/* Tim Knapen's SP-1-dev wiki sequence as used by Tape Looper (HP_TIM_TEST
 * branch of hp_codec_init()): CS42L42 is the I2S frame master, PLL from the
 * oscillator-driven 3.072 MHz SCLK, LRCK = 48 kHz (64 SCLK per frame).
 * Requires the oscillator on and the reset released (done by the caller). */
bool cs42_configure(void)
{
	bool ok = true;

	/* SP1FX: analog mute + mixer mute FIRST, before anything is powered. */
	ok &= tpw(0x2001, CS42_HP_CTL_MUTE);
	ok &= tpw(0x2301, CS42_MIX_MUTE);
	ok &= tpw(0x2303, CS42_MIX_MUTE);

	ok &= tpw(0x1508, 0x10);   /* PLL Control 3 */
	ok &= tpw(0x1504, 0x80);   /* PLL Division Fractional Byte 2 */
	ok &= tpw(0x1505, 0x3E);   /* PLL Division Integer */
	ok &= tpw(0x150A, 0x7D);   /* PLL Calibration Ratio */
	ok &= tpw(0x1009, 0x00);   /* MCLK Control */
	ok &= tpw(0x1201, 0x01);   /* MCLK Source Select */
	ok &= tpw(0x120A, 0x01);   /* Input ASRC Clock Select */
	ok &= tpw(0x120B, 0x01);   /* Output ASRC Clock Select */
	ok &= tpw(0x1501, 0x01);   /* PLL Control 1: start */
	ok &= tpw(0x1107, 0x01);   /* Oscillator Switch (SCLK present) */
	for (int t = 0; t < 10; t++) {   /* wait for "SCLK selected" (0x02) */
		k_msleep(1);
		if (tpr(0x1109, &cs42_clk) && cs42_clk == 0x02) {
			break;
		}
	}
	ok &= tpw(0x1007, 0x13);   /* Serial Port SRC Control */
	ok &= tpw(0x1203, 0x1F);   /* FSYNC Pulse Width Lower (64-SCLK frame) */
	ok &= tpw(0x1205, 0x3F);   /* FSYNC Period Lower */
	ok &= tpw(0x1207, 0x34);   /* ASP Clock Config: MASTER */
	ok &= tpw(0x1208, 0x1A);   /* ASP Frame Configuration */
	ok &= tpw(0x2A02, 0x02);   /* Channel 1: 24-bit */
	ok &= tpw(0x2A05, 0x42);   /* Channel 2: phase + 24-bit */
	ok &= tpw(0x2601, 0x4C);   /* SRC Input Sample Rate */
	ok &= tpw(0x2609, 0x4C);   /* SRC Output Sample Rate */
	ok &= tpw(0x2A01, 0x0C);   /* ASP Receive Enable */
	ok &= tpw(0x240E, 0x01);   /* Equalizer Input Mute Control */
	/* SP1FX: Tim/Tape Looper write 0x00 (0 dB) here; keep the mixer muted. */
	ok &= tpw(0x2301, CS42_MIX_MUTE);
	ok &= tpw(0x2303, CS42_MIX_MUTE);
	ok &= tpw(0x1101, 0x96);   /* power up the codec */
	k_msleep(10);              /* HP amp operational after 10 ms */
	ok &= tpw(0x1121, 0x41);   /* Headset switch control */
	ok &= tpw(0x1B74, 0x03);   /* Miscellaneous detect control */
	ok &= tpw(0x1129, 0x01);   /* Headset clamp disable */
	ok &= tpw(0x2001, CS42_HP_CTL_MUTE);   /* HP Control: mute all */
	ok &= tpw(0x1F06, 0x84);   /* DAC Control 2 */
	ok &= tpw(0x2301, CS42_MIX_MUTE);      /* SP1FX: muted (was 0x00) */
	ok &= tpw(0x2303, CS42_MIX_MUTE);
	ok &= tpw(0x1B73, 0xC2);   /* Tip Sense Control */
	ok &= tpw(0x1B75, 0x9F);   /* Mic detect control 1 */
	/* SP1FX: Tim/Tape Looper unmute here (0x2001 = 0x01); we stay muted until
	 * the app has the stream running and the digital level at zero. */
	return ok;
}

/* Called only while the digital signal is ramped to zero.
 * Order: on = mixer volume then analog unmute; off = analog mute then mixer. */
static uint8_t hp_att = CS42_HP_MIX_ATT;

bool cs42_hp_set_att(uint8_t att_db, bool hp_on)
{
	hp_att = att_db > 0x3Eu ? 0x3Eu : att_db;
	if (!hp_on) {
		return true;
	}
	bool ok = tpw(0x2301, hp_att);

	ok &= tpw(0x2303, hp_att);
	return ok;
}

bool cs42_hp_enable(bool on)
{
	bool ok = true;

	if (on) {
		ok &= tpw(0x2301, hp_att);
		ok &= tpw(0x2303, hp_att);
		ok &= tpw(0x2001, CS42_HP_CTL_ON);
	} else {
		ok &= tpw(0x2001, CS42_HP_CTL_MUTE);
		ok &= tpw(0x2301, CS42_MIX_MUTE);
		ok &= tpw(0x2303, CS42_MIX_MUTE);
	}
	return ok;
}

/* DET_STATUS1 (page 0x1B reg 0x77) bit 7, per Tim's wiki "request headphone
 * status" (datasheet 7.9.8). */
int cs42_hp_present(void)
{
	uint8_t st;

	if (!tpr(0x1B77, &st)) {
		return -1;
	}
	return (st >> 7) & 1;
}

void sp1_codecs_shutdown(void)
{
	(void)tas_page(0x01);
	(void)tas_wr(0x30, TAS_SPK_GAIN_MUTE);   /* class-D driver mute (as Tape Looper) */
	(void)tas_page(0x00);
	(void)tas_wr(0x40, TAS_DAC_MUTE);
	(void)tpw(0x2001, CS42_HP_CTL_MUTE);
	k_msleep(30);
	(void)tas_wr(0x01, 0x01);                /* TAS2505 software reset */
}
```

## src/sp1_codecs.h
```c
/*
 * SP-1 audio codecs (CS42L42 headphone codec, TAS2505 speaker amp) over I2C.
 * See sp1_codecs.c for provenance (adapted from chattock/sp1-tape-looper,
 * MIT, Copyright (c) 2026 chattock).
 *
 * SPDX-License-Identifier: MIT
 */
#ifndef SP1_CODECS_H
#define SP1_CODECS_H

#include <stdbool.h>
#include <stdint.h>

#define CS42L42_ADDR 0x48u
#define TAS2505_ADDR 0x18u

bool sp1_i2c_ready(void);

/* CS42L42: reads DEVID_AB/CD/E (0x1001..0x1003) into devid[3].
 * Returns true if DEVID_AB == 0x42 (genuine CS42L42). */
bool cs42_probe(uint8_t devid[3]);
/* Full init (I2S frame master, 48 kHz from the 3.072 MHz SCLK). Leaves the
 * headphone output MUTED. Returns true if every register write ACKed. */
bool cs42_configure(void);
/* Headphone output on (unmute + mixer volume) / off (mute). */
bool cs42_hp_enable(bool on);
/* Mixer attenuation used by cs42_hp_enable(true), in dB below the register maximum (0..63;
 * 0x00 = 0 dB, 1 dB per step, per the Linux cs42l42 driver's mixer TLV). Default 30 (the
 * hearing-safe headphone level of every image so far). Written at once when hp_on. */
bool cs42_hp_set_att(uint8_t att_db, bool hp_on);
/* 1 = headphones in the jack, 0 = not, -1 = I2C read failed. */
int cs42_hp_present(void);
/* PLL / clock status byte read during configure (diagnostics). */
uint8_t cs42_clk_status(void);

/* TAS2505: true if it ACKs a page-select write. */
bool tas_probe(void);
/* Full init (PLL locked to BCLK). Leaves the speaker MUTED. */
bool tas_configure(void);
/* Speaker on (DAC unmuted, minimum non-zero driver gain) / off (muted). */
bool tas_spk_enable(bool on);

/* Before SYSTEM_OFF: mute both outputs, soft-reset the TAS2505. */
void sp1_codecs_shutdown(void);

#endif
```
